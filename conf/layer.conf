## conf/layer.conf
```bitbake
# We have a conf and classes directory, append to BBPATH
BBPATH .= ":${LAYERDIR}"

# We have a recipes directory, add to BBFILES
BBFILES += "${LAYERDIR}/recipes*/*/*.bb ${LAYERDIR}/recipes*/*/*.bbappend"

BBFILE_COLLECTIONS += "meta-dss11-devel"
BBFILE_PATTERN_meta-dss11-devel := "^${LAYERDIR}/"
BBFILE_PRIORITY_meta-dss11-devel = "20"
```
